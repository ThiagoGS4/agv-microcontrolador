## main/Kconfig.projbuild
```kconfig
menu "Configuration"

    config BROKER_URL
        string "Broker URL"
        default "mqtt://mqtt.eclipseprojects.io"
        help
            URL of the broker to connect to

    config BROKER_URL_FROM_STDIN
        bool
        default y if BROKER_URL = "FROM_STDIN"

    config WIFI_SSID
        string "SSID"
        default "ssid"

    config WIFI_PASSWORD
        string "Senha"
        default "pass"

endmenu
```
